#include "krylo.dtsi"

&default_transform {
    col-offset = <5>;
};

&kscan0 {
    row-gpios 
        = <&pro_micro 14 (GPIO_ACTIVE_HIGH)>
        , <&pro_micro 16 (GPIO_ACTIVE_HIGH)>
        , <&pro_micro 10 (GPIO_ACTIVE_HIGH)>
        , <&pro_micro 9 (GPIO_ACTIVE_HIGH)>
        ;
    col-gpios
        = <&pro_micro_d 15 (GPIO_ACTIVE_HIGH | GPIO_PULL_DOWN)>
        , <&pro_micro_d 18 (GPIO_ACTIVE_HIGH | GPIO_PULL_DOWN)>
        , <&pro_micro_d 19 (GPIO_ACTIVE_HIGH | GPIO_PULL_DOWN)>
        , <&pro_micro_d 20 (GPIO_ACTIVE_HIGH | GPIO_PULL_DOWN)>
        , <&pro_micro_d 21 (GPIO_ACTIVE_HIGH | GPIO_PULL_DOWN)>
        ;
};
