## Kconfig
```kconfig
# SPDX-License-Identifier: MIT

config KRYLO_LED_BATTERY
	bool "krylo battery LED indication behavior"
	depends on ZMK_BATTERY_REPORTING
	default y
	select LED
	help
		Behavior that blinks a configured LED a number of times to indicate the current battery charge level.
		The charge is divided into a configurable number of stages (100% / stages); the LED blinks once per stage.
		Defaults to 3 stages (3 blinks when above 66%, 2 when above 33%, 1 otherwise).
		Each half blinks its own LED with its own battery level when the bound key is pressed on that half.

config KRYLO_LANG_PERSIST
	bool "Persist the active language layer across reboots"
	depends on SETTINGS
	depends on !ZMK_SPLIT || ZMK_SPLIT_ROLE_CENTRAL
	default y
	help
		Saves whether the Cyrillic base layer is active and restores it on boot.
		The host's OS input source is not changed, so it may be out of sync.

config KRYLO_LANG_CYR_LAYER
	int "Layer index of the Cyrillic base layer"
	default 1
	help
		Index of the Cyrillic secondary base layer to persist. Must match U_CYR in keymap/macros.h.

config KRYLO_LANG_SAVE_DEBOUNCE
	int "Debounce (ms) for persisting the language layer"
	depends on KRYLO_LANG_PERSIST
	default 1000
	help
		Delay between the last language toggle and the flash write that persists it.
		A small value persists promptly; the write is deferred off the keypress path
		so typing is not stalled by flash access.
```

## boards/shields/krylo/Kconfig.defconfig
```kconfig
if SHIELD_KRYLO_LEFT
    config ZMK_KEYBOARD_NAME
        default "krylo"
    config ZMK_SPLIT_ROLE_CENTRAL
        default y
endif

if SHIELD_KRYLO_LEFT || SHIELD_KRYLO_RIGHT
    config ZMK_BLE # Needs to be explicit
        default y
    config ZMK_SPLIT
        default y
endif
```

## boards/shields/krylo/Kconfig.shield
```kconfig
config SHIELD_KRYLO_LEFT
    def_bool $(shields_list_contains,krylo_left)

config SHIELD_KRYLO_RIGHT
    def_bool $(shields_list_contains,krylo_right)
```

## dts/bindings/krylo,led-battery.yaml
```yaml
# SPDX-License-Identifier: MIT

description: Blinks a configured LED to indicate the battery charge level

compatible: "krylo,led-battery"

properties:
  "#binding-cells":
    type: int
    required: true
    const: 0
  label:
    type: string
    required: false
    deprecated: true
  leds:
    type: phandles
    required: true
    description: LED device(s) to blink. The nice!nano blue LED, or the red one on the nice!nano clone
  brightness:
    type: int
    default: 100
    description: LED brightness in percent while lit
  on-ms:
    type: int
    default: 200
    description: Milliseconds each blink stays on
  off-ms:
    type: int
    default: 200
    description: Milliseconds between blinks
  stages:
    type: int
    default: 3
    description: Number of charge stages; each spans 100/stages percent, blinking once per stage
```
